## include/build/frdm_kl25z/Kconfig/boards/Kconfig.defconfig
```kconfig
# Load Zephyr board defconfig descriptions.
osource "C:/Users/samub/.platformio/packages/framework-zephyr/boards/nxp/frdm_kl25z/Kconfig.defconfig"
```
